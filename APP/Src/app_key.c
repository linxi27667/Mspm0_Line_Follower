/**
 * @file    app_key.c
 * @brief   Debounced active-low key inputs generated by SysConfig.
 */
#include "app_key.h"

#include "ti_msp_dl_config.h"

typedef struct {
    GPIO_Regs *port;
    uint32_t pin;
    uint32_t raw_change_ms;
    bool raw_pressed;
    bool stable_pressed;
    bool armed;
    bool press_pending;
} app_key_state_t;

static app_key_state_t s_keys[APP_KEY_COUNT] = {
    {
        .port = KEY1_GPIO_PORT,
        .pin = KEY1_GPIO_KEY1_PIN_PIN,
    },
    {
        .port = KEY2_GPIO_PORT,
        .pin = KEY2_GPIO_KEY2_PIN_PIN,
    },
    {
        .port = KEY3_GPIO_PORT,
        .pin = KEY3_GPIO_KEY3_PIN_PIN,
    },
    {
        .port = KEY4_GPIO_PORT,
        .pin = KEY4_GPIO_KEY4_PIN_PIN,
    },
};

static bool App_Key_Read_Active_Low(const app_key_state_t *key)
{
    return (DL_GPIO_readPins(key->port, key->pin) & key->pin) == 0u;
}

void App_Key_Init(uint32_t now_ms)
{
    uint32_t index;

    for (index = 0u; index < APP_KEY_COUNT; index++) {
        bool pressed = App_Key_Read_Active_Low(&s_keys[index]);

        s_keys[index].raw_change_ms = now_ms;
        s_keys[index].raw_pressed = pressed;
        s_keys[index].stable_pressed = pressed;
        /*
         * A key held during reset must be released before it can create an
         * event. This prevents an accidental rehome immediately after boot.
         */
        s_keys[index].armed = !pressed;
        s_keys[index].press_pending = false;
    }
}

void App_Key_Update(uint32_t now_ms)
{
    uint32_t index;

    for (index = 0u; index < APP_KEY_COUNT; index++) {
        app_key_state_t *key = &s_keys[index];
        bool pressed = App_Key_Read_Active_Low(key);

        if (pressed != key->raw_pressed) {
            key->raw_pressed = pressed;
            key->raw_change_ms = now_ms;
            continue;
        }
        if ((pressed == key->stable_pressed) ||
            ((uint32_t)(now_ms - key->raw_change_ms) <
             APP_KEY_DEBOUNCE_MS)) {
            continue;
        }

        key->stable_pressed = pressed;
        if (pressed) {
            if (key->armed) {
                key->press_pending = true;
            }
            key->armed = false;
        } else {
            key->armed = true;
        }
    }
}

bool App_Key_Take_Press(app_key_id_t key)
{
    bool pending;

    if ((uint32_t)key >= APP_KEY_COUNT) {
        return false;
    }
    pending = s_keys[(uint32_t)key].press_pending;
    s_keys[(uint32_t)key].press_pending = false;
    return pending;
}

bool App_Key_Is_Pressed(app_key_id_t key)
{
    if ((uint32_t)key >= APP_KEY_COUNT) {
        return false;
    }
    return s_keys[(uint32_t)key].stable_pressed;
}

void App_Key_Clear_Events(void)
{
    uint32_t index;

    for (index = 0u; index < APP_KEY_COUNT; index++) {
        s_keys[index].press_pending = false;
    }
}
